## examples/esp-idf/01_ESP_IDF_ST7789/sdkconfig.defaults
```kconfig
#
# Partition Table
#
CONFIG_PARTITION_TABLE_CUSTOM=y
CONFIG_PARTITION_TABLE_CUSTOM_FILENAME="partitions.csv"
CONFIG_PARTITION_TABLE_FILENAME="partitions.csv"

#
# Disable Task Watchdog Timer
#
CONFIG_ESP_TASK_WDT_EN=n

#
# ESP32-specific
#
CONFIG_ESP32_DEFAULT_CPU_FREQ_240=y
CONFIG_ESP32_DEFAULT_CPU_FREQ_MHZ=240

#
# ESP32S2-specific
#
CONFIG_ESP32S2_DEFAULT_CPU_FREQ_240=y
CONFIG_ESP32S2_DEFAULT_CPU_FREQ_MHZ=240

#
# ESP32S3-specific
#
CONFIG_ESP32S3_DEFAULT_CPU_FREQ_240=y
CONFIG_ESP32S3_DEFAULT_CPU_FREQ_MHZ=240

# ESP32-S3-Touch-LCD-1.69 V2.1 schematic / HARDWARE_REFERENCE.md: ST7789V2 SPI pins and 240x280 panel geometry.
CONFIG_WIDTH=240
CONFIG_HEIGHT=280
CONFIG_OFFSETX=0
CONFIG_OFFSETY=0
CONFIG_MOSI_GPIO=7
CONFIG_SCLK_GPIO=6
CONFIG_CS_GPIO=5
CONFIG_DC_GPIO=4
CONFIG_RESET_GPIO=8
CONFIG_BL_GPIO=15
```
